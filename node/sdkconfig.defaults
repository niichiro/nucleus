## node/sdkconfig.defaults
```kconfig
# ------------------- Wi-Fi (нужен драйверу ESP-NOW) -------------------
CONFIG_ESP_WIFI_ENABLED=y
CONFIG_ESP_WIFI_STA=y
CONFIG_ESP_WIFI_DYNAMIC_RX_BUFFER_NUM=32
CONFIG_ESP_WIFI_DYNAMIC_TX_BUFFER_NUM=32

# Не использовать автоматический Light Sleep
CONFIG_PM_ENABLE=n

# ------------------- Bluetooth (BLE, NimBLE) -------------------
CONFIG_BT_ENABLED=y
CONFIG_BT_CONTROLLER_ENABLED=y
CONFIG_BT_NIMBLE_ENABLED=y
CONFIG_BT_NIMBLE_MAX_CONNECTIONS=3
CONFIG_BT_NIMBLE_GATT_MAX_SERVICES=4
CONFIG_BT_NIMBLE_GATT_MAX_CHARACTERISTICS=8
CONFIG_BT_NIMBLE_ROLE_PERIPHERAL=y
CONFIG_BT_NIMBLE_ROLE_CENTRAL=n
# У C3 нет классического Bluetooth
CONFIG_BT_CLASSIC_ENABLED=n

# ------------------- Система -------------------
CONFIG_ESP_MAIN_TASK_STACK_SIZE=16384
CONFIG_FREERTOS_HZ=1000
CONFIG_ESP_SYSTEM_EVENT_TASK_STACK_SIZE=4096

# ------------------- Периферия -------------------
CONFIG_UART_ISR_IN_IRAM=y
CONFIG_SPI_FLASH_ROM_DRIVER_PATCH=y
```

## nucleus-node/sdkconfig.defaults
```kconfig
# ------------------- Wi‑Fi -------------------
CONFIG_ESP_WIFI_ENABLED=n
CONFIG_ESP_WIFI_STA_DISCONNECTED_PM_ENABLE=n
CONFIG_ESP_WIFI_DYNAMIC_RX_BUFFER_NUM=32
CONFIG_ESP_WIFI_DYNAMIC_TX_BUFFER_NUM=32

# Не использовать автоматический Light Sleep
CONFIG_PM_ENABLE=n

# ------------------- ESP‑NOW -------------------
CONFIG_ESP_NOW_ENABLED=y
CONFIG_ESP_NOW_MAX_ENCRYPT_NUM=8
CONFIG_ESP_NOW_MAX_ENCRYPT_KEY=32

# ------------------- Bluetooth -------------------
CONFIG_BT_ENABLED=y
CONFIG_BT_CONTROLLER_ENABLED=y
CONFIG_BT_CONTROLLER_ONLY=y
CONFIG_BT_CONTROLLER_TASK_HIGH_PRIORITY=n

# BLE через NimBLE (рекомендовано для Rust)
CONFIG_BT_NIMBLE_ENABLED=y
CONFIG_BT_NIMBLE_HOST_BASED_ON_CONTROLLER=y
CONFIG_BT_NIMBLE_MAX_CONNECTIONS=3
CONFIG_BT_NIMBLE_GATT_MAX_SERVICES=4
CONFIG_BT_NIMBLE_GATT_MAX_CHARACTERISTICS=8
CONFIG_BT_NIMBLE_ROLE_PERIPHERAL=y
CONFIG_BT_NIMBLE_ROLE_CENTRAL=y

# Отключить классический BT (только BLE)
CONFIG_BT_CLASSIC_ENABLED=y

# ------------------- Zigbee (опционально) -------------------
CONFIG_ZIGBEE_ENABLED=y

# ------------------- Система -------------------
CONFIG_ESP_MAIN_TASK_STACK_SIZE=8192
CONFIG_FREERTOS_HZ=1000
CONFIG_ESP_SYSTEM_EVENT_TASK_STACK_SIZE=4096

# ------------------- Периферия -------------------
CONFIG_UART_ISR_IN_IRAM=y
CONFIG_SPI_FLASH_ROM_DRIVER_PATCH=y
```
